## keeb-module/dts/bindings/keeb,engine.yaml
```yaml
# Copyright (c) 2025 The keeb keyboard authors
# SPDX-License-Identifier: MIT

description: |
  Live keymap mutation engine (keeb,engine).

  The node is the engine's data: which behaviors a host may bind, and which
  key positions the engine owns and refuses to rebind over the TLV channel.
  Written from scratch; ZMK Studio is not involved.

  tokens is the token table, and token id = index into this list. The host
  references behaviors by that number, never by a name, because ZMK resolves a
  binding by device-name string and a behavior that is not in the image cannot
  be bound. Reordering this list changes the protocol's meaning, so the engine
  publishes a hash of it (keeb_info.token_hash) and the configurator refuses to
  write when the hash disagrees.

  Behaviors whose driver is not compiled in (a feature switched off) are
  detected at runtime and reported as unavailable, so listing one here is
  harmless.

compatible: "keeb,engine"

properties:
  tokens:
    type: phandles
    required: true
    description:
      Behaviors the TLV channel may bind, in token-id order.

  reserved-positions:
    type: array
    required: true
    description:
      Stock key positions the engine owns. Writes to them are refused, so a
      layout sent by the configurator can never take away the keys the revert
      chord is made of. They keep whatever the keymap file defines for them.

  revert-hold-ms:
    type: int
    default: 3000
    description:
      How long every reserved position must be held together to discard the
      saved keymap and fall back to the keymap file. Works on raw key
      positions, so it cannot be defeated by rebinding.
```

## status-led/Kconfig
```kconfig
config ZMK_STATUS_LED
	bool "Status LED: boot/connect/advertising/battery-error indicators"
	default n
	# The driver sets a brightness per channel through Zephyr's LED API, so the
	# LED subsystem has to exist even on a board with no backlight and no
	# underglow (both are what normally `select LED`). `pwm-leds` channels need
	# the PWM subsystem too; the condition keeps it out of a GPIO-only build.
	select LED
	select PWM if DT_HAS_PWM_LEDS_ENABLED

if ZMK_STATUS_LED

config ZMK_STATUS_LED_BRIGHTNESS_PERCENT
	int "Brightness of every lit signal (%)"
	range 1 100
	default 50
	help
	  The level every lit signal is driven at: boot blinks, the connect flash,
	  the advertising pulse, the layer color and the battery-error red all use
	  this one value, so the palette stays readable relative to itself. 100 is
	  full on.

	  On a `pwm-leds` channel this is the duty cycle of a hardware PWM output:
	  a real brightness change, no flicker at the period the devicetree asks
	  for, and no CPU work - the dimming is done by the peripheral. 0% (an
	  unlit signal) and 100% (solid) both stop the PWM peripheral and write the
	  pad directly, so only a dimmed channel costs the peripheral any running
	  time.

	  On a `gpio-leds` channel (plain SoC GPIO or a GPIO expander) it is
	  ignored - a GPIO channel is on or off - and the driver logs that once at
	  boot instead of pretending. To dim those channels, move them to a
	  PWM-capable pad or raise the series resistors.

config ZMK_STATUS_LED_BATTERY_ERROR_LEVEL
	int "Battery charge level (percent) that latches the solid error state"
	range 0 100
	default 10

config ZMK_STATUS_LED_BOOT_BLINKS
	int "Number of quick blinks at boot"
	range 1 10
	default 3

config ZMK_STATUS_LED_ADV_PERIOD_MS
	int "Advertising blink period in ms"
	range 200 60000
	default 2000

config ZMK_STATUS_LED_ADV_PULSE_MS
	int "Advertising blink on-time in ms"
	range 20 1000
	default 100

endif # ZMK_STATUS_LED
```

## status-led/dts/bindings/zmk,status-led.yaml
```yaml
description: |
  Three-channel (RGB) status LED driven by the zmk-status-led module.

  The three properties point at Zephyr LED devices, i.e. children of a
  `gpio-leds` or a `pwm-leds` node. Which one decides whether the palette can
  be dimmed: `pwm-leds` channels get a real duty cycle from
  CONFIG_ZMK_STATUS_LED_BRIGHTNESS_PERCENT, `gpio-leds` channels are on/off
  and ignore it.

  Example (dimmable, SoC PWM outputs):

    leds {
        compatible = "pwm-leds";
        led_r: led_r { pwms = <&pwm1 0 PWM_USEC(2000) PWM_POLARITY_NORMAL>; };
        led_g: led_g { pwms = <&pwm1 1 PWM_USEC(2000) PWM_POLARITY_NORMAL>; };
        led_b: led_b { pwms = <&pwm1 2 PWM_USEC(2000) PWM_POLARITY_NORMAL>; };
    };

    status_led_device {
        compatible = "zmk,status-led";
        led-r = <&led_r>;
        led-g = <&led_g>;
        led-b = <&led_b>;
    };

    /* nRF52 PWM outputs are routed to the pads through PSEL, so the
     * controller needs default + sleep pinctrl states (the sleep state with
     * low-power-enable is what drops the pads on a PM suspend): */
    &pinctrl {
        status_led_pwm_default: status_led_pwm_default {
            group1 {
                psels = <NRF_PSEL(PWM_OUT0, 0, 2)>,
                        <NRF_PSEL(PWM_OUT1, 0, 29)>,
                        <NRF_PSEL(PWM_OUT2, 0, 31)>;
            };
        };
        status_led_pwm_sleep: status_led_pwm_sleep {
            group1 {
                psels = <NRF_PSEL(PWM_OUT0, 0, 2)>,
                        <NRF_PSEL(PWM_OUT1, 0, 29)>,
                        <NRF_PSEL(PWM_OUT2, 0, 31)>;
                low-power-enable;
            };
        };
    };

    &pwm1 {
        status = "okay";
        pinctrl-0 = <&status_led_pwm_default>;
        pinctrl-1 = <&status_led_pwm_sleep>;
        pinctrl-names = "default", "sleep";
    };

  Example (on/off only, plain GPIO or an I2C expander):

    leds {
        compatible = "gpio-leds";
        led_r: led_r { gpios = <&expander 5 GPIO_ACTIVE_HIGH>; };
        led_g: led_g { gpios = <&expander 6 GPIO_ACTIVE_HIGH>; };
        led_b: led_b { gpios = <&expander 7 GPIO_ACTIVE_HIGH>; };
    };

  Use one PWM instance for all three channels: the nRF52 PWM peripheral has
  three output channels and they share a single period, so the whole RGB set
  must agree on it. Keep that instance away from any other user of PWM that
  changes its period (a buzzer tone is the period), and keep the period short
  enough not to flicker - 2 ms is the value the keeb wiring uses.

  State palette (see src/status_led.c): red = battery error (solid),
  green = profile connected (150 ms flash), blue = advertising (slow
  pulse), white = boot blinks. All lit signals run at
  CONFIG_ZMK_STATUS_LED_BRIGHTNESS_PERCENT.

compatible: "zmk,status-led"

properties:
  led-r:
    type: phandle
    required: true
    description: Red channel (a gpio-leds or pwm-leds child).
  led-g:
    type: phandle
    required: true
    description: Green channel (a gpio-leds or pwm-leds child).
  led-b:
    type: phandle
    required: true
    description: Blue channel (a gpio-leds or pwm-leds child).
```
