## buzzer/dts/bindings/behaviors/zmk,behavior-buzzer.yaml
```yaml
# Copyright (c) 2025 The keeb keyboard authors
# SPDX-License-Identifier: MIT

description: |
  Play a buzzer tune, then - if a `target` is given - invoke that behavior once
  the tone has finished.

  Example (keeb.dtsi, used by the left-half reset chord in keeb.keymap):

    behaviors {
        buzzer_reset: buzzer_reset {
            compatible = "zmk,behavior-buzzer";
            target = <&sys_reset>;
            #binding-cells = <0>;
        };

        buzzer_boot: buzzer_boot {
            compatible = "zmk,behavior-buzzer";
            target = <&bootloader>;
            tune = "bootloader";
            #binding-cells = <0>;
        };
    };

    /* in the keymap's combos { } */
    left_reset_combo {
        key-positions = <KEEB_POS_L_TOP_0 KEEB_POS_L_TOP_1>;
        bindings = <&buzzer_reset>;
    };

  Why it is one behavior and not two bindings: a ZMK combo holds a single
  behavior binding, and &sys_reset reboots inside its own callback - so a chord
  bound to &sys_reset is dead before it could beep. This behavior starts the
  tone asynchronously and re-invokes the target on a work item after the tone
  ends (plus CONFIG_ZMK_BUZZER_LEAD_MS), which is what makes the sound land
  *before* the action without blocking ZMK's behavior queue.

  Without `target` the behavior is a pure sound and can be bound to any key.

  Requires a `zmk,buzzer` device on this half; on a half without one the tone
  reports "no buzzer" and the target runs immediately.

compatible: "zmk,behavior-buzzer"

include: zero_param.yaml

properties:
  tune:
    type: string
    required: false
    default: random
    enum:
      - random
      - layer_on
      - layer_off
      - bootloader
      - update_ok
      - update_fail
      - wake
    description: |
      Which tune to play. `random` (the default) draws a fresh rhythm and pitch per
      press, which is the right choice when a sound only has to say "this happened";
      a named tune says *which* one - see buzzer/README.md for what each one sounds
      like and why. A name outside this list is a build error.

  target:
    type: phandle
    required: false
    description: |
      Behavior node to invoke after the tone finishes, e.g. <&sys_reset> or
      <&bootloader>. A phandle carries no parameters, so a target that needs
      them has to be a dedicated node with its own binding (the way
      keeb,remote-reset wraps &sys_reset for the right half).
```

## buzzer/dts/bindings/zmk,buzzer.yaml
```yaml
# Copyright (c) 2025 The keeb keyboard authors
# SPDX-License-Identifier: MIT

description: |
  One PASSIVE buzzer module (KY-006 / HW-508 piezo) driven by a hardware PWM
  output.

  A passive piezo has no onboard oscillator: a static HIGH on the signal line is
  silence. It sounds only when the line is driven with a square wave, and the
  frequency of that wave is the pitch - which is why this binding takes a PWM
  specifier instead of a GPIO, and why the driver can randomize pitch as well as
  rhythm.

  Example (keeb left half, keeb_left.overlay, which also enables &pwm0 and
  routes its channel 0 to P1.01):

    buzzer_dev: buzzer {
        compatible = "zmk,buzzer";
        pwms = <&pwm0 0 PWM_USEC(500) PWM_POLARITY_NORMAL>;  /* 2 kHz base */
    };

  The period cell is a base tone period, not a limit: every beep sets its own
  period (its own pitch) at runtime from CONFIG_ZMK_BUZZER_FREQ_MIN_HZ/MAX_HZ,
  and silence is 0% duty. The period cell is only the reference used for the
  silence calls and for the log line at boot.

  KY-006 numbers that matter here: usable ~1.5-2.5 kHz, loudest at its ~2 kHz
  resonance, 3.3-5 V supply, <25 mA.

  The driver parks the output at 0% duty on boot and on the SLEEP activity
  state, and the PWM controller node is expected to carry a `sleep` pinctrl
  state (low-power-enable), because the nRF52840 retains pad state through
  System OFF.

  The optional event properties below make this node sound on its own for things
  it can see by itself (a layer turning on or off, a wake from sleep). Anything
  triggered by a key chord is a `zmk,behavior-buzzer` node instead, and anything
  that happens inside another module (the TLV config engine's update results)
  calls zmk_buzzer_play_tune() from its own source.

compatible: "zmk,buzzer"

include: base.yaml

properties:
  pwms:
    type: phandle-array
    required: true
    description: PWM specifier driving the module's signal (S) pin. Channel 0 is what
      the keeb shield wires. Period in nanoseconds, polarity normal.

  beep-layers:
    type: array
    description: |
      Layer indices this buzzer announces: each one gets the `layer_on` tune when it
      turns on and `layer_off` when it turns off (two rising notes vs. the same two
      notes upside down). Absent means the driver does not subscribe to layer events
      at all.

      A layer index, not a layer node - the same number `&mo`/`&to`/`&tog` take, so
      on the keeb board this is written as <KEEB_LAYER_GAME> from
      keeb-module/dts/keeb-positions.dtsi.

      Momentary layers (&mo / &lt) are worth leaving out: they beep twice per use.
      Layer 0 works but beeps at every boot, because ZMK turns the default layer on
      at boot.

  beep-on-wake:
    type: boolean
    description: |
      Play the `wake` tune when this boot was a wake from ZMK sleep rather than a
      fresh power-on.

      ZMK sleeps with sys_poweroff(), which on the nRF52840 is System OFF: RAM is
      lost and the wake is a cold boot, so the only thing that still knows is the
      SoC's POWER.RESETREAS register (OFF bit = woke from System OFF on a GPIO DETECT
      event, i.e. a key press). The driver reads it once at init and clears only
      that bit, so a soft reset (&sys_reset, &bootloader, which set SREQ) is not
      mistaken for a wake and other reset reasons stay readable.

      Needs a SoC with a reset-reason register; elsewhere the property logs a
      warning and does nothing.
```

## keeb-module/Kconfig
```kconfig
# Copyright (c) 2025 The keeb keyboard authors
# SPDX-License-Identifier: MIT
#
# Options for the keeb module. Everything here is scoped to the keeb shields so
# the module can stay in the workspace without affecting other keyboards.

config KBEEB_UI
	bool "Custom keeb status screen"
	depends on SHIELD_KEEB_LEFT || SHIELD_KEEB_RIGHT
	select ZMK_DISPLAY
	select LV_USE_CANVAS
	select LV_USE_IMAGE
	select LV_USE_THEME_MONO
	select LV_FONT_MONTSERRAT_8
	select LV_FONT_MONTSERRAT_16
	select LV_FONT_MONTSERRAT_26
	default y
	help
	  Replaces ZMK's built-in status screen with the keeb panels: the
	  central half shows the active layer plus both halves' batteries, the
	  peripheral half shows the layer artwork inside a fixed frame.

if KBEEB_UI

choice KBEEB_UI_ROTATION
	prompt "Status screen rotation"
	default KBEEB_UI_ROTATION_0
	help
	  How the UI is rotated relative to the panel's native orientation.
	  The nice!view panel is 160x68 and is mounted horizontally, so 0 is the
	  normal choice; 90/270 lay the UI out in a 68x160 portrait space and
	  rotate it into the panel for a vertically mounted display.

config KBEEB_UI_ROTATION_0
	bool "0 (landscape)"

config KBEEB_UI_ROTATION_90
	bool "90 (portrait)"

config KBEEB_UI_ROTATION_180
	bool "180 (landscape, upside down)"

config KBEEB_UI_ROTATION_270
	bool "270 (portrait, other way)"

endchoice

config KBEEB_UI_ART
	bool "Layer artwork on the peripheral display"
	depends on ZMK_SPLIT
	default y
	help
	  Draws the active layer's artwork on the peripheral half. The artwork
	  is pushed from the central half, which is what keeps the two displays
	  in sync without duplicating ZMK's keymap state.

config KBEEB_UI_CENTRAL_ART
	bool "Layer artwork on the central display"
	default n
	help
	  Let the central half's panel draw KEEB_WID_ART widgets, i.e. the active
	  layer's artwork. Off by default: the generated stencils are tens of
	  kilobytes of flash, and the central's panel is readouts, not pictures.
	  With it off, the TLV channel refuses an ART widget on this half
	  (KEEB_ERR_BAD_WIDGET) instead of drawing a blank, and keeb_display_info
	  reports the limit up front.

config KBEEB_UI_PERIPHERAL_PRESET
	int "Peripheral panel preset at boot"
	depends on ZMK_SPLIT && ZMK_SPLIT_ROLE_CENTRAL=n
	default 0
	help
	  Which built-in widget table the peripheral half starts with. 0 is the
	  layer artwork with a connected-device strip beneath it; 1 is the
	  connected device alone. The central half can edit its own panel over
	  the TLV channel; the peripheral's table is fixed in the image because
	  the peripheral holds no host connection (see README: the relay of
	  *edits* to the right half is not implemented).

config KBEEB_LAYER_LED_INDICATE
	bool "Layer colour indication on the RGB status LED"
	depends on ZMK_STATUS_LED
	default y
	help
	  Lights each half's KY-016 in a solid colour while its non-home
	  layer is active: left half NAV=green FUN=blue, right half
	  MEDIA=green GAME=blue, HOME and anything else off (normal status
	  palette). The peripheral half learns the active layer from the
	  layer_art push, so this rides on KBEEB_UI being enabled.

config KBEEB_ADC_DIAG
	bool "ADC channel scan diagnostic (battery divider hunt)"
	default n
	help
	  TEMPORARY: samples all SAADC inputs with the battery gate off/on
	  and logs millivolts, to find which pin the battery divider really
	  feeds on clone boards. Remove once battery reporting works.

config KBEEB_POWER_DIAG
	bool "Log the inherited nRF52840 power state at boot"
	depends on SOC_SERIES_NRF52X
	default y
	help
	  Logs the DCDCEN0/DCDCEN (REG0/REG1 stage) mode inherited from the
	  bootloader plus the UICR REGOUT0 LDO level, so an unregulated VDD on
	  undocumented clone hardware can be attributed. See
	  boards/shields/keeb/power.c.

config KBEEB_POWER_FORCE_LDO
	bool "Force both nRF52840 regulator stages to LDO at boot"
	depends on KBEEB_POWER_DIAG
	default y
	help
	  Zephyr never clears DCDCEN0/DCDCEN (soc.c only sets them when the
	  devicetree nodes are okay), so a bootloader-left DCDC mode survives
	  into the app. With the clone boards missing the buck inductors that
	  means VDD rides at VDDH (battery/USB) - unregulated and out of spec.
	  This clears both enable bits at boot, making the app's supply mode
	  deterministic: LDO, the only mode that regulates on this hardware.

config KBEEB_UI_LAYER_SYNC_POLL_MS
	int "Peripheral link poll interval (ms)"
	depends on ZMK_SPLIT && ZMK_SPLIT_ROLE_CENTRAL
	default 1000
	help
	  ZMK raises no central-side event when a peripheral connects, so the
	  link indicator and the artwork push rely on this poll. Only a local
	  status read happens per tick; the layer is re-sent once per connect.

# LVGL/ZMK stack and pool overrides live in boards/shields/keeb/Kconfig.defconfig:
# defconfig fragments are sourced after the app's own Kconfig, so a plain
# default here would lose to ZMK's.

endif # KBEEB_UI

menuconfig KBEEB_ENGINE
	bool "Live keymap mutation engine (TLV config channel)"
	depends on !ZMK_SPLIT || ZMK_SPLIT_ROLE_CENTRAL
	# The same prerequisites ZMK Studio's own RPC menu selects
	# (zmk/app/src/studio/Kconfig: ZMK_KEYMAP_SETTINGS_STORAGE depends on
	# SETTINGS and ZMK_BEHAVIOR_LOCAL_IDS), minus nanopb/ring-buffer, which
	# only the protobuf RPC needs and this engine never sees.
	select SETTINGS
	select ZMK_BEHAVIOR_LOCAL_IDS
	select ZMK_BEHAVIOR_METADATA
	select ZMK_KEYMAP_SETTINGS_STORAGE
	select ZMK_KEYMAP_LAYER_REORDERING
	help
	  Rebinds keys and reorders layers at runtime from a TLV config channel
	  written in this module (proto/, engine/, keymap/, transport/). Built
	  from scratch: ZMK Studio's protobuf RPC, its subsystem tables and its
	  transports are NOT used and are NOT compiled.

	  The engine reuses ZMK's own dynamic keymap core rather than
	  implementing a second keymap: CONFIG_ZMK_KEYMAP_SETTINGS_STORAGE
	  provides the mutable in-RAM layout plus its settings (NVS) persistence,
	  and CONFIG_ZMK_KEYMAP_LAYER_REORDERING provides layer add/remove/
	  reorder. Both are core ZMK options that ZMK Studio merely selects, so
	  enabling them here is the same feature without Studio.
	  CONFIG_ZMK_BEHAVIOR_METADATA is selected because a binding is then
	  validated by ZMK's own rule (zmk_behavior_validate_binding) instead of
	  by a copy of it, and because the configurator can ask the firmware
	  what a token's parameters mean rather than duplicating ZMK's keycode
	  tables in JavaScript.

if KBEEB_ENGINE

config KBEEB_ENGINE_BLE
	bool "BLE GATT transport"
	depends on ZMK_BLE
	default y
	help
	  Vendor GATT service carrying the TLV channel: one characteristic for
	  host->keyboard writes (write without response, encryption required),
	  one for keyboard->host notifications.

	  The engine is central-only by design: ZMK resolves bindings on the
	  central and sends the resolved binding to the peripheral
	  (zmk/app/src/split/peripheral.c), so the peripheral executes whatever
	  the central's layout says, and it never holds the host connection
	  that a config channel needs. It also means the revert chord sees both
	  halves' key positions, which is the only place it is detectable.

config KBEEB_ENGINE_FW_VERSION
	int "Firmware version reported to the configurator"
	default 1
	help
	  Sent in keeb_info.fw_version. The configurator shows it and refuses to
	  write when the token-table hash disagrees, which is what keeps a host
	  from binding a behavior it believes sits at a different token id.

endif # KBEEB_ENGINE
```

## keeb-module/boards/shields/keeb/Kconfig.shield
```kconfig
config SHIELD_KEEB_LEFT
	def_bool $(shields_list_contains,keeb_left)

config SHIELD_KEEB_RIGHT
	def_bool $(shields_list_contains,keeb_right)
```

## keeb-module/dts/bindings/behaviors/keeb,layer-art.yaml
```yaml
# Copyright (c) 2025 The keeb keyboard authors
# SPDX-License-Identifier: MIT

description: |
  Layer artwork selector for the keeb split keyboard.

  Invoked by the central half whenever the active layer changes. The behaviour
  has global locality, so ZMK forwards every invocation to the peripherals,
  where it selects which artwork the right hand display paints. param1 is the
  index of the layer whose artwork to show.

compatible: "keeb,layer-art"

include: one_param.yaml
```

## keeb-module/dts/bindings/behaviors/keeb,remote-reset.yaml
```yaml
# Copyright (c) 2025 The keeb keyboard authors
# SPDX-License-Identifier: MIT

description: |
  Forward a reset / bootloader-reset invocation to the peripheral (right)
  half.

  ZMK evaluates combos on the central half, and the stock &sys_reset /
  &bootloader behaviors are source-local - so a combo built from
  right-half keys would reset the LEFT half. A binding for this behavior
  instead reboots the right half: on the central it invokes the target
  behavior on peripheral 0 over the split behavior transport; if invoked on
  the peripheral itself, it runs the target locally. See
  boards/shields/keeb/behavior_remote_reset.c.

compatible: "keeb,remote-reset"

include: zero_param.yaml

properties:
  target:
    type: phandle
    required: true
    description: Behavior to run on the right half (e.g. &sys_reset, &bootloader).
```
